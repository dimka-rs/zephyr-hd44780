## CMakeLists.txt
```
cmake_minimum_required(VERSION 3.13.1)
include($ENV{ZEPHYR_BASE}/cmake/app/boilerplate.cmake NO_POLICY_SCOPE)
project(zephyr-hd44780)

FILE(GLOB app_sources src/*.c)
target_sources(app PRIVATE ${app_sources})
```

## prj.conf
```kconfig
CONFIG_STDOUT_CONSOLE=y
CONFIG_PRINTK=y
CONFIG_DISPLAY=y
CONFIG_ADC=y
CONFIG_BOOTLOADER_MCUBOOT=y
```

## src/main.c
```c
#include <zephyr.h>
#include <sys/printk.h>
#include <device.h>
#include <drivers/gpio.h>
#include <inttypes.h>
#include "button.h"
#include "led.h"
#include "hd44780.h"
#include "adc.h"

const uint8_t str1[] = "@ZephyrIoT";
const uint8_t str2[] = "@NordicTweets";

void main(void)
{
    uint32_t i;
    uint8_t col = 0, btn = 0;
    printk("Start App " __DATE__ " " __TIME__ "\n");

    button_init();
    hd44780_init();
    //adc_init();

    while (1)
    {
        hd44780_cmd(HD44780_CMD_CLEAR, 0);

        hd44780_pos(0, col);
        for(i = 0; i < sizeof(str1) - 1; i++)
        {
            hd44780_data(str1[i]);
        }

        hd44780_pos(1, col);
        for(i = 0; i < sizeof(str2) - 1; i++)
        {
            hd44780_data(str2[i]);
        }
        col++;
        if (col > 3)
            col = 0;

        hd44780_pos(0, 15);
        //btn = adc_sample();
        switch (btn)
        {
            case btn_none:
                hd44780_data(0xBC); // sort of smile, ROM Code: A00
                break;

            case btn_select:
                hd44780_data(0xF4); // omega, ROM Code: A00
                break;

            case btn_left:
                hd44780_data(0x7F); // left arrow, ROM Code: A00
                break;

            case btn_down:
                hd44780_data('v');
                break;

            case btn_up:
                hd44780_data('^');
                break;

            case btn_right:
                hd44780_data(0x7E); // right arrow, ROM Code: A00
                break;

            default:
                hd44780_data('E');
                break;
        }

        k_sleep(K_MSEC(1000));
    }
}
```

## src/adc.c
```c
#include <zephyr.h>
#include <drivers/adc.h>
#include "adc.h"
#include <string.h>

// based on https://github.com/zephyrproject-rtos/zephyr/blob/master/tests/drivers/adc/adc_api/src/test_adc.c

// NRF52 specific
#include <hal/nrf_saadc.h>
#define ADC_RESOLUTION		10
#define ADC_GAIN		ADC_GAIN_1_6
#define ADC_REFERENCE		ADC_REF_INTERNAL
#define ADC_ACQUISITION_TIME	ADC_ACQ_TIME(ADC_ACQ_TIME_MICROSECONDS, 10)
#define ADC_1ST_CHANNEL_ID	0
#define ADC_1ST_CHANNEL_INPUT	NRF_SAADC_INPUT_AIN1 // Arduino A0, P0.03
//#define ADC_2ND_CHANNEL_ID	2
//#define ADC_2ND_CHANNEL_INPUT	NRF_SAADC_INPUT_AIN2

static int16_t sample;
const static struct device *adc_dev;

static const struct adc_channel_cfg m_1st_channel_cfg = {
	.gain             = ADC_GAIN,
	.reference        = ADC_REFERENCE,
	.acquisition_time = ADC_ACQUISITION_TIME,
	.channel_id       = ADC_1ST_CHANNEL_ID,
#if defined(CONFIG_ADC_CONFIGURABLE_INPUTS)
	.input_positive   = ADC_1ST_CHANNEL_INPUT,
#endif
};


void
adc_init()
{
    adc_dev = device_get_binding("adc");
    if (!adc_dev)
        printk("Failed to get ADC device\n");

    if (adc_channel_setup(adc_dev, &m_1st_channel_cfg))
        printk("Failed to set up ADC channel 1\n");

    sample = 0;
    printk("ADC init done\n");
}

uint8_t
adc_sample()
{
    uint8_t btn = 0;
    int ret;
    const struct adc_sequence sequence = {
        .channels    = BIT(ADC_1ST_CHANNEL_ID),
        .buffer      = &sample,
        .buffer_size = sizeof(sample),
        .resolution  = ADC_RESOLUTION,
    };

    ret = adc_read(adc_dev, &sequence);
    if (ret)
    {
        printk("ADC channel 1 read error: %d\n", ret);
        return btn_error;
    }


    printk("ADC read: %d\t", sample);
    // open     - 3.4 V - 480..500
    // select   - 3.1 V - 850..890
    // left     - 2.0 V - 550..560
    // down     - 1.2 V - 345..355
    // up       - 0.5 V - 130..140
    // right    - 0 V   - -5..0

    printk("Button: ");
    if(sample > 480 && sample < 500)
    {
        printk("none");
        btn = btn_none;
    }
    else if (sample > 850 && sample < 890 )
    {
        printk("select");
        btn = btn_select;
    }
    else if (sample > 545 && sample < 600)
    {
        printk("left");
        btn = btn_left;
    }
    else if (sample > 340 && sample < 360)
    {
        printk("down");
        btn = btn_down;
    }
    else if (sample > 125 && sample < 145)
    {
        printk("up");
        btn = btn_up;
    }
    else if (sample > -10 && sample < 10)
    {
        printk("right");
        btn = btn_right;
    } else {
        printk("wrong reading");
        btn = btn_error;
    }
    printk("\n");
    return btn;
}
```

## src/adc.h
```c
#ifndef ADC_C
#define ADC_C

void adc_init();
uint8_t adc_sample();

enum adc_button
{
    btn_error,
    btn_none,
    btn_select,
    btn_left,
    btn_down,
    btn_up,
    btn_right
};

#endif //ADC_C
```

## src/button.c
```c
#include <zephyr.h>
#include <inttypes.h>
#include <device.h>
#include <drivers/gpio.h>
#include "button.h"


static struct btns_s btns = {
    .port = NULL,
    .btn[BTN1] = BTN1_PIN,
    .btn[BTN2] = BTN2_PIN,
};

static struct gpio_callback gpio_cb[BTNS_MAX];

void

button_pressed(const struct device *dev, struct gpio_callback *cb,
                uint32_t pins)
{
    printk("Button %d (de)pressed at %u\n", pins,  k_cycle_get_32());
}

void
button_init()
{
    btns.port = device_get_binding(BTN_PORT);
    if (btns.port == NULL) {
        printk("Get binding error" BTN_PORT "\n");
        return;
    }

    for (uint8_t i = 0; i < BTNS_MAX; i++)
    {
        gpio_pin_configure(btns.port, btns.btn[i],
               GPIO_INPUT | GPIO_INT_EDGE_BOTH | GPIO_PULL_UP );
        gpio_init_callback(&gpio_cb[i], button_pressed, BIT(btns.btn[i]));
        gpio_add_callback(btns.port, &gpio_cb[i]);
    }

    printk("BTNs init done\n");
}
```

## src/button.h
```c
#ifndef BUTTON_H
#define BUTTON_H

#define BTN_PORT     "GPIO_0"
#define BTN1_PIN     (13)
#define BTN2_PIN     (14)
/* Pins 15 and 16 used for LCD */

#define EDGE    (GPIO_INT_EDGE | GPIO_INT_ACTIVE_LOW)

enum btns_e
{
    BTN1,
    BTN2,
    BTNS_MAX
};

struct btns_s
{
    const struct device *port;
    uint32_t btn[BTNS_MAX];
};

void button_init();

#endif //BUTTON_H
```

## src/hd44780.c
```c
#include <stdint.h>
#include <drivers/gpio.h>
#include "hd44780.h"

static struct hd44780_display disp = {
    .port = NULL,
    .pin[D4] = HD44780_PIN_D4,
    .pin[D5] = HD44780_PIN_D5,
    .pin[D6] = HD44780_PIN_D6,
    .pin[D7] = HD44780_PIN_D7,
    .pin[RS] = HD44780_PIN_RS,
    .pin[EN] = HD44780_PIN_EN,
};

static inline void
hd44780_pulse()
{
    // en
    gpio_pin_set(disp.port, disp.pin[EN], 1);
    // ds says min 1 us, but only 1000 works reliably
    k_usleep(1000);
    // dis
    gpio_pin_set(disp.port, disp.pin[EN], 0);
}

static inline void
hd44780_nibble(uint8_t n)
{
    gpio_pin_set(disp.port, disp.pin[RS], 0); //cmd
    gpio_pin_set(disp.port, disp.pin[D7], (n & (1 << 7)) ? 1 : 0);
    gpio_pin_set(disp.port, disp.pin[D6], (n & (1 << 6)) ? 1 : 0);
    gpio_pin_set(disp.port, disp.pin[D5], (n & (1 << 5)) ? 1 : 0);
    gpio_pin_set(disp.port, disp.pin[D4], (n & (1 << 4)) ? 1 : 0);
    hd44780_pulse();
}

static void
hd44780_byte(uint8_t b)
{
    // high nibble
    gpio_pin_set(disp.port, disp.pin[D7], (b & (1 << 7)) ? 1 : 0);
    gpio_pin_set(disp.port, disp.pin[D6], (b & (1 << 6)) ? 1 : 0);
    gpio_pin_set(disp.port, disp.pin[D5], (b & (1 << 5)) ? 1 : 0);
    gpio_pin_set(disp.port, disp.pin[D4], (b & (1 << 4)) ? 1 : 0);
    hd44780_pulse();
    // low nibble
    gpio_pin_set(disp.port, disp.pin[D7], (b & (1 << 3)) ? 1 : 0);
    gpio_pin_set(disp.port, disp.pin[D6], (b & (1 << 2)) ? 1 : 0);
    gpio_pin_set(disp.port, disp.pin[D5], (b & (1 << 1)) ? 1 : 0);
    gpio_pin_set(disp.port, disp.pin[D4], (b & (1 << 0)) ? 1 : 0);
    hd44780_pulse();

    // most commands take about 37 us, 1000 to be safe
    k_usleep(10000);
}

void
hd44780_data(uint8_t val)
{
    // rs high - data
    gpio_pin_set(disp.port, disp.pin[RS], 1);
    hd44780_byte(val);
}

void
hd44780_cmd(uint8_t cmd, uint8_t flags)
{
    cmd |= flags;
    // rs low - command
    gpio_pin_set(disp.port, disp.pin[RS], 0);
    hd44780_byte(cmd);
}

void
hd44780_pos(uint8_t row, uint8_t col)
{
    uint8_t addr;

    switch (row)
    {
        case 0:
            addr = 0x00;
            break;
        case 1:
            addr = 0x40;
            break;
        default:
            return;
    }

    if (col < 16)
        addr += col;
    else
        return;

    hd44780_cmd(HD44780_CMD_DDRAM, addr);
}

void
hd44780_init()
{
    uint32_t i;

    disp.port = device_get_binding(HD44780_PORT);
    if (disp.port == NULL)
    {
        printk("HD44780: Failed to get binding for " HD44780_PORT "\n");
        return;
    }

    for(i = 0; i < PINS_MAX; i++)
    {
        int res = gpio_pin_configure(disp.port, disp.pin[i], GPIO_OUTPUT);
        if (res != 0)
        {
            printk("HD44780: Failed to configure pin %u: %d\n", disp.pin[i], res);
        }
    }

    // display starts in 8 bit mode, so first command must pulse enable only once
    // _nibble will do this using only high nibble, though only bus width can be set
    hd44780_nibble(HD44780_CMD_CONFIG | HD44780_CONFIG_DATA4 );
    // this command is long
    k_sleep(K_MSEC(10));

    // Display 16x2, Font 5x8
    hd44780_cmd(HD44780_CMD_CONFIG, HD44780_CONFIG_2LINES|HD44780_CONFIG_5X8|HD44780_CONFIG_DATA4);
    k_sleep(K_MSEC(10));

    // On
    hd44780_cmd(HD44780_CMD_ONOFF, HD44780_ONOFF_DISP_ON);
    k_sleep(K_MSEC(10));

    printk("HD44780 init done\n");
}
```

## src/hd44780.h
```c
#ifndef HD44780_H
#define HD44780_H

#include <zephyr.h>

/* LCD shield pinout
 *  Ard nRF     Usage
 *  A0  0.03    Buttons
 *  D4  0.15    DB4
 *  D5  0.16    DB5
 *  D6  0.17    DB6
 *  D7  0.18    DB7
 *  D8  0.19    RS
 *  D9  0.20    EN
 */

#define HD44780_PORT   "GPIO_0"
#define HD44780_PIN_D4 (15)
#define HD44780_PIN_D5 (16)
#define HD44780_PIN_D6 (17)
#define HD44780_PIN_D7 (18)
#define HD44780_PIN_RS (19)
#define HD44780_PIN_EN (20)

enum hd44780_pins
{
    D4,
    D5,
    D6,
    D7,
    RS,
    EN,
    PINS_MAX
};

enum hd44780_cmds
{
    HD44780_CMD_CLEAR = 1,
    HD44780_CMD_HOME = 2,
    HD44780_CMD_MODE = 4,
        HD44780_MODE_INC = 2,
        HD44780_MODE_DEC = 0,
        HD44780_MODE_SHIFT = 1,
    HD44780_CMD_ONOFF = 8,
        HD44780_ONOFF_DISP_ON = 4,
        HD44780_ONOFF_DISP_OFF = 0,
        HD44780_ONOFF_CURS_ON = 2,
        HD44780_ONOFF_CURS_OFF = 0,
        HD44780_ONOFF_BLINK_ON = 1,
        HD44780_ONOFF_BLINK_OFF = 0,
    HD44780_CMD_SHIFT = 16,
        HD44780_SHIFT_DISP = 8,
        HD44780_SHIFT_CURS = 0,
        HD44780_SHIFT_RIGHT = 4,
        HD44780_SHIFT_LEFT = 0,
    HD44780_CMD_CONFIG = 32,
        HD44780_CONFIG_DATA8 = 16,
        HD44780_CONFIG_DATA4 = 0,
        HD44780_CONFIG_2LINES = 8,
        HD44780_CONFIG_1LINE0 = 0,
        HD44780_CONFIG_5X11 = 4,
        HD44780_CONFIG_5X8 = 0,
    HD44780_CMD_CGRAM = 64,
    HD44780_CMD_DDRAM = 128,
};

struct hd44780_display
{
    const struct device *port;
    uint32_t pin[PINS_MAX];
};

void hd44780_init();
void hd44780_cmd(uint8_t cmd, uint8_t flags);
void hd44780_data(uint8_t val);
void hd44780_pos(uint8_t row, uint8_t col);


#endif // HD44780_H
```

## src/led.c
```c
#include <zephyr.h>
#include <inttypes.h>
#include <device.h>
#include <drivers/gpio.h>
#include "led.h"

static struct leds_s leds = {
    .port = NULL,
    .led[LED1] = LED1_PIN,
    .led[LED2] = LED2_PIN,
    .led[LED3] = LED3_PIN,
    .led[LED4] = LED4_PIN,
};

void
len_on(uint8_t l)
{
    gpio_pin_set(leds.port, leds.led[l], 1);
}

void
len_off(uint8_t l)
{
    gpio_pin_set(leds.port, leds.led[l], 0);
}

void
led_init()
{
    leds.port = device_get_binding(LED_PORT);
    if (!leds.port) {
        printk("Get led binding error\n");
        return;
    }

    /* Set LEDs pins as output */
    for(uint8_t i = 0; i < LEDS_MAX; i++)
    {
        gpio_pin_configure(leds.port, leds.led[i], GPIO_OUTPUT);
    }
    printk("LEDs init done\n");
}
```

## src/led.h
```c
#ifndef LED_H
#define LED_H

#define LED_PORT    ("GPIO_0")
#define LED1_PIN     (17)
#define LED2_PIN     (18)
#define LED3_PIN     (19)
#define LED4_PIN     (20)

enum leds_e
{
    LED1,
    LED2,
    LED3,
    LED4,
    LEDS_MAX
};

struct leds_s
{
    const struct device *port;
    uint32_t led[LEDS_MAX];
};


void led_init();
void len_on(uint8_t l);
void len_off(uint8_t l);


#endif // LED_H
```
